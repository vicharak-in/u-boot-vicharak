## arch/arm/mach-rockchip/rk3588/Kconfig
```kconfig
if ROCKCHIP_RK3588

config TARGET_RK3588_NEU6
	bool "Edgeble Neural Compute Module 6(Neu6) SoM"
	select BOARD_LATE_INIT
	help
	  Neu6:
	  Neural Compute Module 6A(Neu6a) is a 96boards SoM-CB compute module
	  based on Rockchip RK3588 from Edgeble AI.

	  Neu6-IO:
	  Neural Compute Module 6(Neu6) IO board is an industrial form factor
	  IO board and Neu6a needs to mount on top of this IO board in order to
	  create complete Edgeble Neural Compute Module 6(Neu6) IO platform.

config TARGET_ROCK5B_RK3588
	bool "Radxa ROCK5B RK3588 board"
	select BOARD_LATE_INIT
	help
	  Radxa ROCK5B is a Rockchip RK3588 based SBC (Single Board Computer)
	  by Radxa.

	  There are tree variants depending on the DRAM size : 4G, 8G and 16G.

	  Specification:

	  Rockchip Rk3588 SoC
	  4x ARM Cortex-A76, 4x ARM Cortex-A55
	  4/8/16GB memory LPDDR4x
	  Mali G610MC4 GPU
	  MIPI CSI 2 multiple lanes connector
	  eMMC module connector
	  uSD slot (up to 128GB)
	  2x USB 2.0, 2x USB 3.0
	  2x HDMI output, 1x HDMI input
	  Ethernet port
	  40-pin IO header including UART, SPI, I2C and 5V DC power in
	  USB PD over USB Type-C
	  Size: 85mm x 54mm

config TARGET_RK3588_AXON
	bool "Vicharak RK3588 Axon board"
	select BOARD_LATE_INIT
	help
	  The Axon is a Single Board Computer (SBC) designed by Vicharak,
	  which is powered by the RK3588 processor.

	  The board features a dual-channel DDR4 RAM configuration
	  with a total capacity of 8GB, as well as storage options
	  including SATA, NVMe, eMMC, and SDMMC.

	  Other notable features include a 1GBps LAN connection,
	  RTL8852BS-based WiFi and Bluetooth module,
	  ES8388 Audio codec support, MIPI CSI RX x 2,
	  MIPI DCPHY RX x 2, MIPI DCPHY TX x 2 and 3 x PCIe 2.0 and 1 x 3.0 slots.

	  The Axon also includes a variety of header pins
	  for UART, I2C, SPI, and SARADC connectivity,
	  as well as micro HDMI ports and
	  2 x USB Type-C connectors for power delivery, 3.1 USB and DP.

config ROCKCHIP_BOOT_MODE_REG
	default 0xfd588080

config ROCKCHIP_STIMER_BASE
	default 0xfd8c8000

config SYS_SOC
	default "rk3588"

config SYS_MALLOC_F_LEN
	default 0x80000

source board/edgeble/neural-compute-module-6/Kconfig
source board/radxa/rock5b-rk3588/Kconfig
source board/vicharak/rk3588-axon/Kconfig

endif
```
